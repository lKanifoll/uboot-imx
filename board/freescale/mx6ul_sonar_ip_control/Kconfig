## board/freescale/mx6ul_sonar_ip_control/Kconfig
```kconfig
if TARGET_MX6UL_SONAR_IP_CONTROL

config SYS_BOARD
	default "mx6ul_sonar_ip_control"

config SYS_VENDOR
	default "freescale"

config SYS_SOC
	default "mx6"

config SYS_CONFIG_NAME
	default "mx6ul_sonar_ip_control"

endif
```

## configs/mx6ul_sonar_ip_control_defconfig
```kconfig
CONFIG_SYS_EXTRA_OPTIONS="IMX_CONFIG=board/freescale/mx6ul_sonar_ip_control/imximage.cfg,MX6UL"
CONFIG_ARM=y
CONFIG_TARGET_MX6UL_SONAR_IP_CONTROL=y
CONFIG_DM=y
CONFIG_DM_THERMAL=y
```
